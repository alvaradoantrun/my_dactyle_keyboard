/ {
    chosen {
        zmk,keyboard = &kb;
    };

    kb: keyboard {
        compatible = "zmk,keyboard";
        diode-direction = "row2col";

        kscan: kscan {
            compatible = "zmk,kscan-gpio-matrix";

            row-gpios = <&gpio0 31 GPIO_ACTIVE_HIGH>,   /* 031 = P0.31 */
                        <&gpio0 29 GPIO_ACTIVE_HIGH>,   /* 029 = P0.29 */
                        <&gpio0 2  GPIO_ACTIVE_HIGH>,   /* 002 = P0.02 */
                        <&gpio1 15 GPIO_ACTIVE_HIGH>,   /* 115 = P1.15 */
                        <&gpio1 13 GPIO_ACTIVE_HIGH>,   /* 113 = P1.13 */
                        <&gpio0 10 GPIO_ACTIVE_HIGH>;   /* 010 = P0.10 */

            col-gpios = <&gpio0 17 GPIO_ACTIVE_HIGH>,   /* 017 = P0.17 */
                        <&gpio0 20 GPIO_ACTIVE_HIGH>,   /* 020 = P0.20 */
                        <&gpio0 22 GPIO_ACTIVE_HIGH>,   /* 022 = P0.22 */
                        <&gpio0 24 GPIO_ACTIVE_HIGH>,   /* 024 = P0.24 */
                        <&gpio1 0  GPIO_ACTIVE_HIGH>,   /* 100 = P1.00 */
                        <&gpio0 11 GPIO_ACTIVE_HIGH>,   /* 011 = P0.11 */
                        <&gpio1 6  GPIO_ACTIVE_HIGH>;   /* 106 = P1.06 */
        };
    };
};
